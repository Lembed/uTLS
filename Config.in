## Config.in
```kconfig
#
# For a description of the syntax of this configuration file,
# see scripts/config/Kconfig-language.txt
#

mainmenu "axTLS Configuration"

config HAVE_DOT_CONFIG
    bool
    default y

choice 
    prompt "Platform"
    default CONFIG_PLATFORM_LINUX

config CONFIG_PLATFORM_LINUX
    bool "Linux"

endchoice 

menu "General Configuration"

config PREFIX
    string "axTLS installation prefix"
    depends on !CONFIG_PLATFORM_WIN32
    default "/usr/local"
    help
      Define your directory to install axTLS files/subdirs in.

config CONFIG_DEBUG
    bool "Build axTLS with Debugging symbols"
    default n
    help
      Say Y here if you wish to compile axTLS with debugging symbols.
      This will allow you to use a debugger to examine axTLS internals.  
      This increases the size of the binary considerably and should only be 
      used when doing development.
      If you are doing development and want to debug axTLS, answer Y.

      Most people should answer N.

config CONFIG_STRIP_UNWANTED_SECTIONS
    depends on !CONFIG_PLATFORM_WIN32 && !CONFIG_DEBUG
    bool "Strip unwanted sections from elf binaries"
    default y
    help
        Strip unwanted sections from the resulting binaries


config CONFIG_EXTRA_CFLAGS_OPTIONS
    string "Any extra CFLAGS options for the compiler?"
    help
        Do you want to pass any extra CFLAGS options to the compiler as  
        you build axTLS? If so, this is the option for you...  For
        example, if you want to add some simple compiler switches (like
        -march=i686), or check for warnings using -Werror, just those 
        options here.

config CONFIG_EXTRA_LDFLAGS_OPTIONS
    string "Any extra LDFLAGS options for the compiler?"
    help
        Do you want to pass any extra LDFLAGS options to the compiler?

endmenu

source ssl/Config.in
config CONFIG_AXTLSWRAP
    depends on !CONFIG_PLATFORM_WIN32
    bool "Enable axtlswrap"
    default n
    help
        axtlswrap is similar to sslwrap - http://www.rickk.com/sslwrap. 
        It enables SSL for processes that don't have native SSL support.

config CONFIG_AXHTTPD
    bool "Enable HTTP/HTTPS Web Server"
    default y
    help
        Build the AXHTTPD web server

source samples/httpd/Config.in
source samples/Config.in
source ssl/BigIntConfig.in
```

## httpd/Config.in
```kconfig
#
# For a description of the syntax of this configuration file,
# see scripts/config/Kconfig-language.txt
#

menu "Axhttpd Configuration"
depends on CONFIG_AXHTTPD

config CONFIG_HTTP_STATIC_BUILD
    bool "Static Build"
    default n
    help
        Select y if you want axhttpd to be a static build (i.e. don't use the
        axtls shared library or dll).
        
config CONFIG_HTTP_PORT
    int "HTTP port"
    default 80
    help
        The port number of the normal HTTP server. 

        You must be a root user in order to use the default port.

config CONFIG_HTTP_HTTPS_PORT
    int "HTTPS port"
    default 443
    help
        The port number of the HTTPS server.

        You must be a root user in order to use the default port.

config CONFIG_HTTP_SESSION_CACHE_SIZE
    int "SSL session cache size"
    default 5
    help
        The size of the SSL session cache.
        
        This is not actually related to the number of concurrent users, but 
        for optimum performance they should be the same (with a penalty 
        in memory usage).

config CONFIG_HTTP_WEBROOT
    string "Web root location"
    default "../www" if !CONFIG_PLATFORM_WIN32
    help
        The location of the web root in relation to axhttpd. This is 
        the directory where index.html lives.

config CONFIG_HTTP_TIMEOUT
    int "Timeout"
    default 300
    help
        Set the timeout of a connection in seconds.

config CONFIG_HTTP_DIRECTORIES
    bool "Enable Directory Listing"
    default y
    help
        Enable directory listing.
    
config CONFIG_HTTP_HAS_AUTHORIZATION
    bool "Enable authorization"
    default y
    help
        Pages/directories can have passwords associated with them.

config CONFIG_HTTP_HAS_IPV6
    bool "Enable IPv6"
    default n
    help
        Use IPv6 instead of IPv4.

config CONFIG_HTTP_ENABLE_DIFFERENT_USER
    bool "Enable different user"
    default n
    help
        Allow the web server to be run as a different user
    
config CONFIG_HTTP_USER
    string "As User"
    default "nobody"
    depends on CONFIG_HTTP_ENABLE_DIFFERENT_USER
    help
        The user name that will be used to run axhttpd.

config CONFIG_HTTP_VERBOSE
    bool "Verbose Mode"
    default y if CONFIG_SSL_FULL_MODE
    default n if !CONFIG_SSL_FULL_MODE
    help
        Enable extra statements used when using axhttpd.

config CONFIG_HTTP_IS_DAEMON
    bool "Run as a daemon"
    default n
    help 
        Run axhttpd as a background process.

endmenu
```

## samples/Config.in
```kconfig
#
# For a description of the syntax of this configuration file,
# see scripts/config/Kconfig-language.txt
#
menu "Samples"

config CONFIG_SAMPLES
    bool "Create Samples"
    default y
    help
        axTLS contains various sample code.

        Select Y here if you want to build the various samples.

config CONFIG_C_SAMPLES
    bool "axssl - C version"
    default y
    depends on CONFIG_SAMPLES
    help
        Build the "C" version of axssl. The features enabled are very
        dependent on the build mode ('full' mode will give all features).

endmenu
```
